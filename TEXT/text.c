#include "text.h"
#include "oled.h"

const uint8_t OLED_HZK[15][32]=
{
{0x24,0x10,0x24,0x60,0x25,0x80,0x7F,0xFF,0xC4,0x80,0x44,0x60,0x00,0x81,0x03,0x01,0x1C,0x02,0x00,0x02,0xFF,0xE4,0x00,0x08,
0x10,0x30,0x08,0xC0,0x06,0x00,0x00,0x00},/*"秒",0*/
{0x00,0x84,0x20,0x84,0x24,0x88,0x24,0x90,0x24,0xBF,0x24,0xC1,0x24,0x82,0xFF,0xC4,0x24,0xA0,0x24,0x90,0x24,0x88,0x24,0x94,
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0x24,0x01,0x24,0x01,0x20,0x01,0x00,0x00},/*"度",13*/
};	
	 
//在指定位置，显示一个16*16大小的汉字
//x,y :汉字的坐标
//fnum:汉字编号（在字库数组里面的编号） 
void OLED_Show_Font(uint16_t x,uint16_t y,uint8_t fnum)
{
	uint8_t temp,t,t1;
	uint16_t y0=y;
	uint8_t *dzk;   
	uint8_t csize=32;					//一个16*16的汉字32字节
	dzk=(uint8_t*)OLED_HZK[fnum];	//得到汉字编号对应的点阵库 
	for(t=0;t<csize;t++)
	{   												   
		temp=dzk[t];				//得到点阵数据                          
		for(t1=0;t1<8;t1++)
		{
			if(temp&0x80)
				OLED_DrawPoint(x,y,1);
			else 
				OLED_DrawPoint(x,y,0); 
			temp<<=1;
			y++;
			if((y-y0)==16)
			{
				y=y0;
				x++;
				break;
			}
		}  	 
	}  
}




void Show_Font(uint16_t x,uint16_t y,uint8_t size,uint8_t mode,uint8_t fnum)
{
	uint8_t temp,t,t1;
	uint16_t y0=y;
	uint8_t *dzk;   
	uint8_t csize=size*size/8;					//一个汉字对应的字节
	dzk=(uint8_t*)OLED_HZK[fnum];	//得到汉字编号对应的点阵库 
	for(t=0;t<csize;t++)
	{   												   
		temp=dzk[t];				//得到点阵数据                          
		for(t1=0;t1<8;t1++)
		{
			if(temp&0x80)
				OLED_DrawPoint(x,y,mode); //mode=1,正常显示
			else 
				OLED_DrawPoint(x,y,!mode); 
			temp<<=1;
			y++;
			if((y-y0)==size)
			{
				y=y0;
				x++;
				break;
			}
		}  	 
	}  
}











